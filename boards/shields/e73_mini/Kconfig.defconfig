## boards/shields/e73_mini/Kconfig.defconfig
```kconfig
# Copyright (c) 2020 The ZMK Contributors
# SPDX-License-Identifier: MIT

if SHIELD_E73_MINI

config ZMK_KEYBOARD_NAME
    default "e73_mini"

endif
```

## boards/shields/e73_mini/Kconfig.shield
```kconfig
# Copyright (c) 2020 The ZMK Contributors
# SPDX-License-Identifier: MIT

config SHIELD_E73_MINI
    def_bool $(shields_list_contains,e73_mini)
```

## boards/shields/lemon_mini/Kconfig.defconfig
```kconfig
# Copyright (c) 2020 The ZMK Contributors
# SPDX-License-Identifier: MIT

if SHIELD_LEMON_MINI

config ZMK_KEYBOARD_NAME
    default "lemon_mini"

endif
```

## boards/shields/lemon_mini/Kconfig.shield
```kconfig
# Copyright (c) 2020 The ZMK Contributors
# SPDX-License-Identifier: MIT

config SHIELD_LEMON_MINI
    def_bool $(shields_list_contains,lemon_mini)
```
